/dts-v1/;
/plugin/;

/ {
    overlay-name = "DOFBOT I2C7 100 kHz test";
    jetson-header-name = "Jetson 40pin Header";
    compatible = "nvidia,p3768-0000+p3767-0005-super", "nvidia,p3767-0005", "nvidia,tegra234";

    fragment@0 {
        target-path = "/bus@0/i2c@c250000";
        __overlay__ {
            clock-frequency = <100000>;
        };
    };
};
